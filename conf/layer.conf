## conf/layer.conf
```bitbake
# We have a conf and classes directory, add to BBPATH
BBPATH .= ":${LAYERDIR}"

# We have recipes-* directories, add to BBFILES
BBFILES += "${LAYERDIR}/recipes-*/*/*.bb \
	${LAYERDIR}/recipes-*/*/*.bbappend"

BBFILE_COLLECTIONS += "lab"
BBFILE_PATTERN_lab = "^${LAYERDIR}/"
BBFILE_PRIORITY_lab = "10"

LAYERSERIES_COMPAT_lab = "zeus"
```
